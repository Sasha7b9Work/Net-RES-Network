#include "Font.h"
const Font22 font12_10 = {
	12, 	10, {
/*0*/		{ 10, { 767,	767,	767,	767,	767,	767,	767,	767,	767,	767,	767,	767	} },	
/*1*/		{ 10, { 765,	513,	513,	513,	513,	513,	513,	513,	513,	513,	513,	765	} },	
/*2*/		{ 1, { 1,	1,	1,	1,	1,	1,	1,	1,	1,	1,	1,	1	} },	
/*3*/		{ 0, { 0,	0,	0,	0,	0,	0,	0,	0,	0,	0,	0,	0	} },	
/*4*/		{ 0, { 0,	0,	0,	0,	0,	0,	0,	0,	0,	0,	0,	0	} },	
/*5*/		{ 0, { 0,	0,	0,	0,	0,	0,	0,	0,	0,	0,	0,	0	} },	
/*6*/		{ 0, { 0,	0,	0,	0,	0,	0,	0,	0,	0,	0,	0,	0	} },	
/*7*/		{ 0, { 0,	0,	0,	0,	0,	0,	0,	0,	0,	0,	0,	0	} },	
/*8*/		{ 0, { 0,	0,	0,	0,	0,	0,	0,	0,	0,	0,	0,	0	} },	
/*9*/		{ 0, { 0,	0,	0,	0,	0,	0,	0,	0,	0,	0,	0,	0	} },	
/*10*/		{ 0, { 0,	0,	0,	0,	0,	0,	0,	0,	0,	0,	0,	0	} },	
/*11*/		{ 0, { 0,	0,	0,	0,	0,	0,	0,	0,	0,	0,	0,	0	} },	
/*12*/		{ 0, { 0,	0,	0,	0,	0,	0,	0,	0,	0,	0,	0,	0	} },	
/*13*/		{ 5, { 4,	14,	31,	4,	4,	31,	14,	4,	0,	0,	0,	0	} },	
/*14*/		{ 10, { 124,	898,	5,	9,	17,	1,	1,	898,	0,	0,	0,	0	} },	
/*15*/		{ 1, { 0,	0,	1,	1,	1,	1,	1,	0,	0,	0,	0,	0	} },	
/*16*/		{ 0, { 0,	0,	0,	0,	0,	0,	0,	0,	0,	0,	0,	0	} },	
/*17*/		{ 0, { 0,	0,	0,	0,	0,	0,	0,	0,	0,	0,	0,	0	} },	
/*18*/		{ 0, { 0,	0,	0,	0,	0,	0,	0,	0,	0,	0,	0,	0	} },	
/*19*/		{ 0, { 0,	0,	0,	0,	0,	0,	0,	0,	0,	0,	0,	0	} },	
/*20*/		{ 0, { 0,	0,	0,	0,	0,	0,	0,	0,	0,	0,	0,	0	} },	
/*21*/		{ 0, { 0,	0,	0,	0,	0,	0,	0,	0,	0,	0,	0,	0	} },	
/*22*/		{ 0, { 0,	0,	0,	0,	0,	0,	0,	0,	0,	0,	0,	0	} },	
/*23*/		{ 0, { 0,	0,	0,	0,	0,	0,	0,	0,	0,	0,	0,	0	} },	
/*24*/		{ 0, { 0,	0,	0,	0,	0,	0,	0,	0,	0,	0,	0,	0	} },	
/*25*/		{ 0, { 0,	0,	0,	0,	0,	0,	0,	0,	0,	0,	0,	0	} },	
/*26*/		{ 0, { 0,	0,	0,	0,	0,	0,	0,	0,	0,	0,	0,	0	} },	
/*27*/		{ 0, { 0,	0,	0,	0,	0,	0,	0,	0,	0,	0,	0,	0	} },	
/*28*/		{ 0, { 0,	0,	0,	0,	0,	0,	0,	0,	0,	0,	0,	0	} },	
/*29*/		{ 0, { 0,	0,	0,	0,	0,	0,	0,	0,	0,	0,	0,	0	} },	
/*30*/		{ 7, { 124,	0,	0,	0,	0,	0,	0,	0,	0,	0,	0,	0	} },	
/*31*/		{ 0, { 0,	0,	0,	0,	0,	0,	0,	0,	0,	0,	0,	0	} },	
/*32*/		{ 0, { 0,	0,	0,	0,	0,	0,	0,	0,	0,	0,	0,	0	} },	
/*33*/		{ 3, { 4,	4,	4,	4,	4,	0,	4,	0,	0,	0,	0,	0	} },	
/*34*/		{ 3, { 5,	5,	0,	0,	0,	0,	0,	0,	0,	0,	0,	0	} },	
/*35*/		{ 5, { 0,	10,	31,	10,	10,	31,	10,	0,	0,	0,	0,	0	} },	
/*36*/		{ 5, { 0,	4,	31,	5,	31,	20,	31,	4,	0,	0,	0,	0	} },	
/*37*/		{ 6, { 0,	35,	19,	8,	4,	50,	49,	0,	0,	0,	0,	0	} },	
/*38*/		{ 5, { 0,	4,	10,	4,	26,	9,	22,	0,	0,	0,	0,	0	} },	
/*39*/		{ 3, { 0,	4,	2,	0,	0,	0,	0,	0,	0,	0,	0,	0	} },	
/*40*/		{ 2, { 2,	2,	1,	1,	1,	2,	2,	0,	0,	0,	0,	0	} },	
/*41*/		{ 2, { 1,	1,	2,	2,	2,	1,	1,	0,	0,	0,	0,	0	} },	
/*42*/		{ 3, { 0,	0,	5,	2,	5,	0,	0,	0,	0,	0,	0,	0	} },	
/*43*/		{ 3, { 0,	0,	2,	7,	2,	0,	0,	0,	0,	0,	0,	0	} },	
/*44*/		{ 4, { 0,	0,	0,	0,	0,	8,	4,	0,	0,	0,	0,	0	} },	
/*45*/		{ 3, { 0,	0,	0,	7,	0,	0,	0,	0,	0,	0,	0,	0	} },	
/*46*/		{ 1, { 0,	0,	0,	0,	0,	0,	1,	0,	0,	0,	0,	0	} },	
/*47*/		{ 3, { 0,	4,	4,	2,	2,	1,	1,	0,	0,	0,	0,	0	} },	
/*48*/		{ 4, { 15,	9,	9,	9,	9,	9,	15,	0,	0,	0,	0,	0	} },	
/*49*/		{ 4, { 6,	4,	4,	4,	4,	4,	14,	0,	0,	0,	0,	0	} },	
/*50*/		{ 4, { 15,	8,	8,	15,	1,	1,	15,	0,	0,	0,	0,	0	} },	
/*51*/		{ 4, { 15,	8,	8,	15,	8,	8,	15,	0,	0,	0,	0,	0	} },	
/*52*/		{ 4, { 9,	9,	9,	15,	8,	8,	8,	0,	0,	0,	0,	0	} },	
/*53*/		{ 4, { 15,	1,	1,	15,	8,	8,	15,	0,	0,	0,	0,	0	} },	
/*54*/		{ 4, { 15,	1,	1,	15,	9,	9,	15,	0,	0,	0,	0,	0	} },	
/*55*/		{ 4, { 15,	8,	4,	2,	1,	1,	1,	0,	0,	0,	0,	0	} },	
/*56*/		{ 4, { 15,	9,	9,	15,	9,	9,	15,	0,	0,	0,	0,	0	} },	
/*57*/		{ 4, { 15,	9,	9,	15,	8,	8,	15,	0,	0,	0,	0,	0	} },	
/*58*/		{ 1, { 0,	1,	0,	0,	0,	1,	0,	0,	0,	0,	0,	0	} },	
/*59*/		{ 3, { 0,	0,	4,	0,	0,	4,	4,	2,	0,	0,	0,	0	} },	
/*60*/		{ 6, { 0,	36,	18,	9,	18,	36,	0,	0,	0,	0,	0,	0	} },	
/*61*/		{ 3, { 0,	0,	7,	0,	7,	0,	0,	0,	0,	0,	0,	0	} },	
/*62*/		{ 6, { 0,	9,	18,	36,	18,	9,	0,	0,	0,	0,	0,	0	} },	
/*63*/		{ 5, { 0,	14,	17,	8,	4,	0,	4,	0,	0,	0,	0,	0	} },	
/*64*/		{ 4, { 9,	0,	15,	9,	15,	1,	15,	0,	0,	0,	0,	0	} },	
/*65*/		{ 4, { 15,	9,	9,	9,	15,	9,	9,	0,	0,	0,	0,	0	} },	
/*66*/		{ 4, { 7,	9,	9,	7,	9,	9,	7,	0,	0,	0,	0,	0	} },	
/*67*/		{ 4, { 15,	1,	1,	1,	1,	1,	15,	0,	0,	0,	0,	0	} },	
/*68*/		{ 4, { 7,	9,	9,	9,	9,	9,	7,	0,	0,	0,	0,	0	} },	
/*69*/		{ 4, { 15,	1,	1,	7,	1,	1,	15,	0,	0,	0,	0,	0	} },	
/*70*/		{ 4, { 15,	1,	1,	7,	1,	1,	1,	0,	0,	0,	0,	0	} },	
/*71*/		{ 5, { 14,	17,	1,	1,	25,	17,	14,	0,	0,	0,	0,	0	} },	
/*72*/		{ 5, { 17,	17,	17,	31,	17,	17,	17,	0,	0,	0,	0,	0	} },	
/*73*/		{ 5, { 31,	4,	4,	4,	4,	4,	31,	0,	0,	0,	0,	0	} },	
/*74*/		{ 4, { 8,	8,	8,	8,	9,	9,	6,	0,	0,	0,	0,	0	} },	
/*75*/		{ 5, { 17,	9,	5,	3,	5,	9,	17,	0,	0,	0,	0,	0	} },	
/*76*/		{ 4, { 1,	1,	1,	1,	1,	9,	15,	0,	0,	0,	0,	0	} },	
/*77*/		{ 5, { 17,	27,	21,	17,	17,	17,	17,	0,	0,	0,	0,	0	} },	
/*78*/		{ 5, { 17,	17,	19,	21,	21,	25,	17,	0,	0,	0,	0,	0	} },	
/*79*/		{ 5, { 14,	17,	17,	17,	17,	17,	14,	0,	0,	0,	0,	0	} },	
/*80*/		{ 5, { 15,	17,	17,	17,	15,	1,	1,	0,	0,	0,	0,	0	} },	
/*81*/		{ 5, { 14,	17,	17,	17,	21,	9,	22,	0,	0,	0,	0,	0	} },	
/*82*/		{ 5, { 15,	17,	17,	17,	15,	9,	17,	0,	0,	0,	0,	0	} },	
/*83*/		{ 4, { 15,	1,	1,	15,	8,	8,	15,	0,	0,	0,	0,	0	} },	
/*84*/		{ 5, { 31,	4,	4,	4,	4,	4,	4,	0,	0,	0,	0,	0	} },	
/*85*/		{ 5, { 17,	17,	17,	17,	17,	17,	14,	0,	0,	0,	0,	0	} },	
/*86*/		{ 5, { 17,	17,	17,	17,	17,	10,	4,	0,	0,	0,	0,	0	} },	
/*87*/		{ 5, { 17,	17,	17,	17,	17,	21,	10,	0,	0,	0,	0,	0	} },	
/*88*/		{ 5, { 17,	10,	4,	4,	4,	10,	17,	0,	0,	0,	0,	0	} },	
/*89*/		{ 5, { 17,	17,	17,	10,	4,	4,	4,	0,	0,	0,	0,	0	} },	
/*90*/		{ 5, { 31,	16,	8,	4,	2,	1,	31,	0,	0,	0,	0,	0	} },	
/*91*/		{ 4, { 0,	14,	2,	2,	2,	2,	14,	0,	0,	0,	0,	0	} },	
/*92*/		{ 5, { 0,	0,	1,	2,	4,	8,	16,	0,	0,	0,	0,	0	} },	
/*93*/		{ 4, { 0,	14,	8,	8,	8,	8,	14,	0,	0,	0,	0,	0	} },	
/*94*/		{ 5, { 0,	4,	14,	21,	4,	4,	4,	0,	0,	0,	0,	0	} },	
/*95*/		{ 6, { 0,	0,	0,	0,	0,	0,	0,	63,	0,	0,	0,	0	} },	
/*96*/		{ 3, { 6,	2,	7,	2,	2,	2,	2,	0,	0,	0,	0,	0	} },	
/*97*/		{ 4, { 0,	0,	15,	8,	15,	9,	15,	0,	0,	0,	0,	0	} },	
/*98*/		{ 4, { 1,	1,	15,	9,	9,	9,	15,	0,	0,	0,	0,	0	} },	
/*99*/		{ 4, { 0,	0,	15,	1,	1,	1,	15,	0,	0,	0,	0,	0	} },	
/*100*/		{ 4, { 8,	8,	15,	9,	9,	9,	15,	0,	0,	0,	0,	0	} },	
/*101*/		{ 4, { 0,	0,	15,	9,	15,	1,	15,	0,	0,	0,	0,	0	} },	
/*102*/		{ 3, { 6,	2,	7,	2,	2,	2,	2,	0,	0,	0,	0,	0	} },	
/*103*/		{ 4, { 0,	0,	15,	9,	9,	15,	8,	15,	0,	0,	0,	0	} },	
/*104*/		{ 4, { 1,	1,	15,	9,	9,	9,	9,	0,	0,	0,	0,	0	} },	
/*105*/		{ 1, { 1,	0,	1,	1,	1,	1,	1,	0,	0,	0,	0,	0	} },	
/*106*/		{ 4, { 0,	8,	0,	8,	8,	8,	9,	6,	0,	0,	0,	0	} },	
/*107*/		{ 4, { 1,	1,	9,	5,	3,	5,	9,	0,	0,	0,	0,	0	} },	
/*108*/		{ 2, { 1,	1,	1,	1,	1,	1,	3,	0,	0,	0,	0,	0	} },	
/*109*/		{ 5, { 0,	0,	11,	21,	21,	21,	21,	0,	0,	0,	0,	0	} },	
/*110*/		{ 4, { 0,	0,	7,	9,	9,	9,	9,	0,	0,	0,	0,	0	} },	
/*111*/		{ 4, { 0,	0,	15,	9,	9,	9,	15,	0,	0,	0,	0,	0	} },	
/*112*/		{ 4, { 0,	0,	15,	9,	9,	15,	1,	1,	0,	0,	0,	0	} },	
/*113*/		{ 5, { 0,	0,	15,	9,	9,	15,	8,	24,	0,	0,	0,	0	} },	
/*114*/		{ 3, { 0,	0,	7,	1,	1,	1,	1,	0,	0,	0,	0,	0	} },	
/*115*/		{ 4, { 0,	0,	15,	1,	15,	8,	15,	0,	0,	0,	0,	0	} },	
/*116*/		{ 3, { 2,	2,	7,	2,	2,	2,	6,	0,	0,	0,	0,	0	} },	
/*117*/		{ 4, { 0,	0,	9,	9,	9,	9,	15,	0,	0,	0,	0,	0	} },	
/*118*/		{ 5, { 0,	0,	17,	17,	10,	10,	4,	0,	0,	0,	0,	0	} },	
/*119*/		{ 5, { 0,	0,	17,	21,	21,	21,	10,	0,	0,	0,	0,	0	} },	
/*120*/		{ 5, { 0,	0,	17,	10,	4,	10,	17,	0,	0,	0,	0,	0	} },	
/*121*/		{ 4, { 0,	0,	9,	9,	9,	15,	8,	15,	0,	0,	0,	0	} },	
/*122*/		{ 5, { 0,	0,	31,	8,	4,	2,	31,	0,	0,	0,	0,	0	} },	
/*123*/		{ 7, { 31,	4,	4,	4,	4,	116,	84,	112,	0,	0,	0,	0	} },	
/*124*/		{ 7, { 15,	1,	1,	7,	1,	113,	33,	32,	0,	0,	0,	0	} },	
/*125*/		{ 7, { 31,	4,	4,	4,	4,	116,	36,	32,	0,	0,	0,	0	} },	
/*126*/		{ 7, { 0,	0,	6,	73,	48,	0,	0,	0,	0,	0,	0,	0	} },	
/*127*/		{ 2, { 0,	0,	2,	1,	1,	0,	0,	0,	0,	0,	0,	0	} },	
/*128*/		{ 3, { 0,	4,	6,	7,	6,	4,	0,	0,	0,	0,	0,	0	} },	
/*129*/		{ 3, { 0,	1,	3,	7,	3,	1,	0,	0,	0,	0,	0,	0	} },	
/*130*/		{ 10, { 15,	33,	49,	1017,	49,	33,	15,	0,	0,	0,	0,	0	} },	
/*131*/		{ 10, { 903,	69,	39,	16,	8,	996,	930,	993,	0,	0,	0,	0	} },	
/*132*/		{ 6, { 62,	34,	54,	54,	28,	8,	0,	0,	0,	0,	0,	0	} },	
/*133*/		{ 7, { 127,	127,	127,	127,	62,	28,	8,	0,	0,	0,	0,	0	} },	
/*134*/		{ 10, { 0,	1016,	908,	990,	988,	1016,	0,	0,	0,	0,	0,	0	} },	
/*135*/		{ 7, { 0,	31,	49,	123,	59,	31,	0,	0,	0,	0,	0,	0	} },	
/*136*/		{ 7, { 65,	34,	20,	8,	20,	34,	65,	0,	0,	0,	0,	0	} },	
/*137*/		{ 0, { 0,	0,	0,	0,	0,	0,	0,	0,	0,	0,	0,	0	} },	
/*138*/		{ 6, { 62,	34,	42,	34,	62,	0,	0,	0,	0,	0,	0,	0	} },	
/*139*/		{ 7, { 127,	127,	127,	127,	127,	127,	0,	0,	0,	0,	0,	0	} },	
/*140*/		{ 10, { 124,	898,	1,	1,	17,	9,	5,	898,	0,	0,	0,	0	} },	
/*141*/		{ 1, { 0,	0,	1,	1,	1,	1,	1,	0,	0,	0,	0,	0	} },	
/*142*/		{ 5, { 7,	2,	2,	18,	26,	18,	18,	16,	0,	0,	0,	0	} },	
/*143*/		{ 6, { 7,	2,	2,	58,	42,	34,	18,	56,	0,	0,	0,	0	} },	
/*144*/		{ 7, { 0,	8,	8,	8,	8,	127,	0,	0,	0,	0,	0,	0	} },	
/*145*/		{ 7, { 0,	0,	6,	73,	48,	0,	0,	0,	0,	0,	0,	0	} },	
/*146*/		{ 7, { 0,	0,	127,	0,	107,	0,	0,	0,	0,	0,	0,	0	} },	
/*147*/		{ 10, { 31,	63,	127,	1023,	127,	63,	31,	0,	0,	0,	0,	0	} },	
/*148*/		{ 10, { 1016,	1020,	1022,	1023,	1022,	1020,	1016,	0,	0,	0,	0,	0	} },	
/*149*/		{ 5, { 31,	31,	31,	31,	31,	31,	31,	14,	0,	0,	0,	0	} },	
/*150*/		{ 5, { 14,	31,	31,	31,	31,	31,	31,	31,	0,	0,	0,	0	} },	
/*151*/		{ 10, { 0,	36,	102,	1023,	102,	36,	0,	0,	0,	0,	0,	0	} },	
/*152*/		{ 0, { 0,	0,	0,	0,	0,	0,	0,	0,	0,	0,	0,	0	} },	
/*153*/		{ 6, { 0,	8,	16,	63,	16,	8,	0,	0,	0,	0,	0,	0	} },	
/*154*/		{ 5, { 0,	4,	4,	31,	4,	4,	0,	0,	0,	0,	0,	0	} },	
/*155*/		{ 5, { 0,	0,	0,	31,	0,	0,	0,	0,	0,	0,	0,	0	} },	
/*156*/		{ 7, { 124,	0,	0,	0,	0,	0,	0,	0,	0,	0,	0,	0	} },	
/*157*/		{ 0, { 0,	0,	0,	0,	0,	0,	0,	0,	0,	0,	0,	0	} },	
/*158*/		{ 6, { 5,	5,	5,	37,	53,	37,	35,	32,	0,	0,	0,	0	} },	
/*159*/		{ 7, { 5,	5,	5,	117,	85,	69,	35,	112,	0,	0,	0,	0	} },	
/*160*/		{ 7, { 20,	20,	84,	85,	65,	65,	66,	36,	0,	0,	0,	0	} },	
/*161*/		{ 10, { 24,	36,	66,	897,	0,	0,	0,	0,	0,	0,	0,	0	} },	
/*162*/		{ 10, { 0,	0,	0,	0,	897,	66,	36,	24,	0,	0,	0,	0	} },	
/*163*/		{ 5, { 4,	14,	31,	0,	0,	0,	0,	0,	0,	0,	0,	0	} },	
/*164*/		{ 5, { 31,	14,	4,	0,	0,	0,	0,	0,	0,	0,	0,	0	} },	
/*165*/		{ 1, { 0,	1,	0,	0,	0,	1,	0,	0,	0,	0,	0,	0	} },	
/*166*/		{ 7, { 15,	8,	8,	28,	8,	8,	120,	0,	0,	0,	0,	0	} },	
/*167*/		{ 7, { 120,	8,	8,	28,	8,	8,	15,	0,	0,	0,	0,	0	} },	
/*168*/		{ 4, { 6,	9,	9,	6,	0,	0,	0,	0,	0,	0,	0,	0	} },	
/*169*/		{ 0, { 0,	0,	0,	0,	0,	0,	0,	0,	0,	0,	0,	0	} },	
/*170*/		{ 10, { 124,	898,	65,	33,	17,	1,	1,	898,	0,	0,	0,	0	} },	
/*171*/		{ 1, { 0,	0,	1,	1,	1,	1,	1,	0,	0,	0,	0,	0	} },	
/*172*/		{ 10, { 124,	898,	1,	1,	17,	33,	65,	898,	0,	0,	0,	0	} },	
/*173*/		{ 1, { 0,	0,	1,	1,	1,	1,	1,	0,	0,	0,	0,	0	} },	
/*174*/		{ 10, { 3,	15,	63,	1023,	1023,	1023,	1023,	1023,	0,	0,	0,	0	} },	
/*175*/		{ 10, { 0,	0,	0,	0,	3,	15,	63,	1023,	0,	0,	0,	0	} },	
/*176*/		{ 7, { 2,	2,	2,	2,	2,	2,	127,	0,	0,	0,	0,	0	} },	
/*177*/		{ 10, { 936,	2,	0,	2,	0,	2,	1023,	0,	0,	0,	0,	0	} },	
/*178*/		{ 10, { 62,	65,	65,	65,	65,	65,	896,	0,	0,	0,	0,	0	} },	
/*179*/		{ 10, { 124,	898,	898,	898,	898,	898,	1,	0,	0,	0,	0,	0	} },	
/*180*/		{ 10, { 21,	64,	0,	64,	0,	64,	1023,	0,	0,	0,	0,	0	} },	
/*181*/		{ 10, { 1020,	2,	2,	2,	2,	2,	1,	0,	0,	0,	0,	0	} },	
/*182*/		{ 10, { 63,	64,	64,	64,	64,	64,	896,	0,	0,	0,	0,	0	} },	
/*183*/		{ 7, { 42,	42,	42,	42,	42,	42,	127,	0,	0,	0,	0,	0	} },	
/*184*/		{ 4, { 9,	0,	15,	9,	15,	1,	15,	0,	0,	0,	0,	0	} },	
/*185*/		{ 0, { 0,	0,	0,	0,	0,	0,	0,	0,	0,	0,	0,	0	} },	
/*186*/		{ 7, { 124,	0,	0,	0,	0,	0,	0,	0,	0,	0,	0,	0	} },	
/*187*/		{ 0, { 0,	0,	0,	0,	0,	0,	0,	0,	0,	0,	0,	0	} },	
/*188*/		{ 7, { 124,	0,	0,	0,	0,	0,	0,	0,	0,	0,	0,	0	} },	
/*189*/		{ 0, { 0,	0,	0,	0,	0,	0,	0,	0,	0,	0,	0,	0	} },	
/*190*/		{ 10, { 1023,	1023,	1023,	1023,	63,	15,	3,	0,	0,	0,	0,	0	} },	
/*191*/		{ 6, { 63,	15,	3,	0,	0,	0,	0,	0,	0,	0,	0,	0	} },	
/*192*/		{ 6, { 28,	38,	34,	33,	33,	33,	33,	33,	63,	33,	33,	33	} },	
/*193*/		{ 5, { 31,	1,	1,	31,	17,	17,	31,	0,	0,	0,	0,	0	} },	
/*194*/		{ 7, { 31,	33,	33,	33,	33,	33,	63,	65,	65,	65,	65,	63	} },	
/*195*/		{ 4, { 15,	1,	1,	1,	1,	1,	1,	0,	0,	0,	0,	0	} },	
/*196*/		{ 10, { 112,	920,	904,	900,	900,	900,	900,	900,	900,	254,	513,	513	} },	
/*197*/		{ 6, { 62,	1,	1,	1,	1,	31,	1,	1,	1,	1,	1,	62	} },	
/*198*/		{ 5, { 21,	21,	21,	14,	21,	21,	21,	0,	0,	0,	0,	0	} },	
/*199*/		{ 5, { 31,	17,	16,	12,	16,	17,	31,	0,	0,	0,	0,	0	} },	
/*200*/		{ 7, { 65,	97,	97,	81,	81,	73,	73,	69,	69,	67,	67,	65	} },	
/*201*/		{ 5, { 21,	25,	21,	19,	17,	17,	17,	0,	0,	0,	0,	0	} },	
/*202*/		{ 5, { 17,	9,	5,	3,	5,	9,	17,	0,	0,	0,	0,	0	} },	
/*203*/		{ 6, { 28,	34,	34,	33,	33,	33,	33,	33,	33,	33,	33,	33	} },	
/*204*/		{ 5, { 17,	27,	21,	17,	17,	17,	17,	0,	0,	0,	0,	0	} },	
/*205*/		{ 7, { 65,	65,	65,	65,	65,	65,	127,	65,	65,	65,	65,	65	} },	
/*206*/		{ 5, { 31,	17,	17,	17,	17,	17,	31,	0,	0,	0,	0,	0	} },	
/*207*/		{ 5, { 31,	17,	17,	17,	17,	17,	17,	0,	0,	0,	0,	0	} },	
/*208*/		{ 5, { 31,	17,	17,	17,	31,	1,	1,	0,	0,	0,	0,	0	} },	
/*209*/		{ 5, { 31,	17,	1,	1,	1,	17,	31,	0,	0,	0,	0,	0	} },	
/*210*/		{ 5, { 31,	4,	4,	4,	4,	4,	4,	0,	0,	0,	0,	0	} },	
/*211*/		{ 5, { 17,	17,	17,	31,	16,	16,	31,	0,	0,	0,	0,	0	} },	
/*212*/		{ 7, { 127,	73,	73,	73,	127,	8,	8,	0,	0,	0,	0,	0	} },	
/*213*/		{ 5, { 17,	10,	10,	4,	10,	10,	17,	0,	0,	0,	0,	0	} },	
/*214*/		{ 6, { 17,	17,	17,	17,	17,	17,	63,	32,	0,	0,	0,	0	} },	
/*215*/		{ 5, { 17,	17,	17,	17,	31,	16,	16,	0,	0,	0,	0,	0	} },	
/*216*/		{ 5, { 21,	21,	21,	21,	21,	21,	31,	0,	0,	0,	0,	0	} },	
/*217*/		{ 6, { 21,	21,	21,	21,	21,	21,	63,	32,	0,	0,	0,	0	} },	
/*218*/		{ 5, { 3,	2,	2,	30,	18,	18,	30,	0,	0,	0,	0,	0	} },	
/*219*/		{ 6, { 33,	33,	33,	47,	41,	41,	47,	0,	0,	0,	0,	0	} },	
/*220*/		{ 4, { 1,	1,	1,	15,	9,	9,	15,	0,	0,	0,	0,	0	} },	
/*221*/		{ 5, { 31,	16,	16,	31,	16,	16,	31,	0,	0,	0,	0,	0	} },	
/*222*/		{ 6, { 61,	37,	37,	39,	37,	37,	61,	0,	0,	0,	0,	0	} },	
/*223*/		{ 5, { 31,	17,	17,	17,	30,	18,	17,	0,	0,	0,	0,	0	} },	
/*224*/		{ 4, { 0,	0,	15,	8,	15,	9,	15,	0,	0,	0,	0,	0	} },	
/*225*/		{ 4, { 0,	0,	15,	1,	15,	9,	15,	0,	0,	0,	0,	0	} },	
/*226*/		{ 4, { 0,	0,	15,	9,	7,	9,	15,	0,	0,	0,	0,	0	} },	
/*227*/		{ 3, { 0,	0,	7,	1,	1,	1,	1,	0,	0,	0,	0,	0	} },	
/*228*/		{ 6, { 0,	0,	30,	18,	18,	18,	63,	33,	0,	0,	0,	0	} },	
/*229*/		{ 4, { 0,	0,	15,	9,	15,	1,	15,	0,	0,	0,	0,	0	} },	
/*230*/		{ 5, { 0,	0,	21,	21,	14,	21,	21,	0,	0,	0,	0,	0	} },	
/*231*/		{ 4, { 0,	0,	15,	9,	4,	9,	15,	0,	0,	0,	0,	0	} },	
/*232*/		{ 4, { 0,	0,	9,	13,	11,	9,	9,	0,	0,	0,	0,	0	} },	
/*233*/		{ 4, { 0,	4,	9,	13,	11,	9,	9,	0,	0,	0,	0,	0	} },	
/*234*/		{ 4, { 0,	0,	9,	5,	3,	5,	9,	0,	0,	0,	0,	0	} },	
/*235*/		{ 4, { 0,	0,	14,	9,	9,	9,	9,	0,	0,	0,	0,	0	} },	
/*236*/		{ 5, { 0,	0,	17,	27,	21,	17,	17,	0,	0,	0,	0,	0	} },	
/*237*/		{ 4, { 0,	0,	9,	9,	15,	9,	9,	0,	0,	0,	0,	0	} },	
/*238*/		{ 4, { 0,	0,	15,	9,	9,	9,	15,	0,	0,	0,	0,	0	} },	
/*239*/		{ 4, { 0,	0,	15,	9,	9,	9,	9,	0,	0,	0,	0,	0	} },	
/*240*/		{ 4, { 0,	0,	15,	9,	9,	15,	1,	1,	0,	0,	0,	0	} },	
/*241*/		{ 4, { 0,	0,	15,	9,	1,	9,	15,	0,	0,	0,	0,	0	} },	
/*242*/		{ 3, { 0,	0,	7,	2,	2,	2,	2,	0,	0,	0,	0,	0	} },	
/*243*/		{ 4, { 0,	0,	9,	9,	15,	8,	15,	0,	0,	0,	0,	0	} },	
/*244*/		{ 5, { 0,	0,	31,	21,	21,	31,	4,	0,	0,	0,	0,	0	} },	
/*245*/		{ 5, { 0,	0,	17,	10,	4,	10,	17,	0,	0,	0,	0,	0	} },	
/*246*/		{ 5, { 0,	0,	9,	9,	9,	9,	31,	16,	0,	0,	0,	0	} },	
/*247*/		{ 4, { 0,	0,	9,	9,	15,	8,	8,	0,	0,	0,	0,	0	} },	
/*248*/		{ 5, { 0,	0,	21,	21,	21,	21,	31,	0,	0,	0,	0,	0	} },	
/*249*/		{ 6, { 0,	0,	21,	21,	21,	21,	63,	32,	0,	0,	0,	0	} },	
/*250*/		{ 5, { 0,	0,	3,	2,	30,	18,	30,	0,	0,	0,	0,	0	} },	
/*251*/		{ 5, { 0,	0,	17,	17,	23,	21,	23,	0,	0,	0,	0,	0	} },	
/*252*/		{ 4, { 0,	0,	1,	1,	15,	9,	15,	0,	0,	0,	0,	0	} },	
/*253*/		{ 4, { 0,	0,	15,	8,	15,	8,	15,	0,	0,	0,	0,	0	} },	
/*254*/		{ 5, { 0,	0,	29,	21,	23,	21,	29,	0,	0,	0,	0,	0	} },	
/*255*/		{ 4, { 0,	0,	15,	9,	14,	10,	9,	0,	0,	0,	0,	0	} }	
} };
